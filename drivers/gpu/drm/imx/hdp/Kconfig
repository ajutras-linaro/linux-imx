## drivers/gpu/drm/imx/hdp/Kconfig
```kconfig
config DRM_IMX_HDP
	tristate "IMX8 HD Display Controller"
	select DRM_IMX
	select MX8_HDP
	select DRM_KMS_HELPER
	select VIDEOMODE_HELPERS
	select DRM_GEM_CMA_HELPER
	select DRM_KMS_CMA_HELPER
	select DRM_PANEL
	help
	  Choose this if you want to use DP/HDMI on i.MX8.

config IMX_HDP_CEC
	bool "Enable IMX HDP CEC support"
	depends on DRM_IMX_HDP && MEDIA_CEC_SUPPORT
	select CEC_CORE
	---help---
	  When selected the imx hdmi will support the optional
	  HDMI CEC feature.

config DRM_SDP_HDCP_TA
        bool "i.MX8M HDCP/HDMI secure registers"
        default n
        depends on DRM_IMX_HDP
        help
          Support HDCP OPTEE Trusted Application to secure HDMI/HDCP registers for i.MX8MQ processor.
```

## drivers/mxc/hantro_845/Kconfig
```kconfig
#
# Codec configuration
#

menu "MXC HANTRO(Video Processing Unit) 845 support"
	depends on ARCH_FSL_IMX8MQ && TEE && OPTEE

config MXC_HANTRO_845
	tristate "Support for MXC HANTRO(Video Processing Unit) 845"
	depends on TEE && OPTEE
	default y
	---help---
	  VPU codec device.

endmenu
```

## drivers/mxc/hantro_secure/Kconfig
```kconfig
#
# Codec configuration
#

menu "MXC HANTRO(Video Processing Unit) Secure support"
	depends on ARCH_FSL_IMX8MQ

config MXC_HANTRO_SECURE
	tristate "Support for Secure VPU driver with OPTEE"
	depends on TEE && OPTEE
	default n
	---help---
	  VPU secure driver.

endmenu
```
